## firmware/sdkconfig.defaults
```kconfig
CONFIG_ESPTOOLPY_FLASHSIZE_2MB=y
CONFIG_PARTITION_TABLE_CUSTOM=y
CONFIG_PARTITION_TABLE_CUSTOM_FILENAME="partitions_two_ota.csv"
CONFIG_ESP_WIFI_ENABLED=y
CONFIG_ESP_TASK_WDT_INIT=y
CONFIG_BOOTLOADER_APP_ROLLBACK_ENABLE=y
```
